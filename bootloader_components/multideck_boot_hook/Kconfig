## bootloader_components/multideck_boot_hook/Kconfig
```kconfig
menu "MultiDeck return button (bootloader)"

    config MULTIDECK_RETURN_GPIO
        int "Button GPIO (pressed = low)"
        default 35
        range 0 54
        help
            The board's BOOT button is GPIO 35. Held down shortly after a reset, it brings back
            MultiDeck instead of the last firmware started.

    config MULTIDECK_RETURN_WINDOW_MS
        int "Time after a reset to look for the button (ms)"
        default 500
        range 0 3000
        help
            Every start waits this long for the button. 0 turns the button check off.

endmenu
```

## main/Kconfig.projbuild
```kconfig
menu "MultiDeck"

    config MULTIDECK_FW_DIR
        string "Firmware folder on the microSD card"
        default "/sdcard/firmware"
        help
            MultiDeck lists the .bin files in this folder. A text file with the same name
            (RigDeck.bin -> RigDeck.txt) can give the title (first line) and a description.

    config MULTIDECK_SPLASH_MS
        int "Start-up screen time (ms)"
        default 2500
        range 0 10000

endmenu
```
